## main/Kconfig.projbuild
```kconfig
menu "Glove identity"

    choice GLOVE_HAND_TYPE
        prompt "Hand type"
        default GLOVE_HAND_LEFT
        help
            Select the identity compiled into this firmware image.

        config GLOVE_HAND_LEFT
            bool "Left hand"

        config GLOVE_HAND_RIGHT
            bool "Right hand"
    endchoice

endmenu
```

## sdkconfig.defaults.left
```kconfig
CONFIG_GLOVE_HAND_LEFT=y
CONFIG_SPIRAM=y
CONFIG_SPIRAM_MODE_OCT=y
CONFIG_SPIRAM_SPEED_80M=y
CONFIG_SPIRAM_USE_CAPS_ALLOC=y
```
